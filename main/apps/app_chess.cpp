#include "app.h"
#include "app_chess.h"
#include "app_registry.h"
#include "chess_rules.h"
#include "hal_config.h"
#include "hal_sleep.h"
#include "mp_session.h"

#include "freertos/FreeRTOS.h"
#include "freertos/task.h"

#include "esp_log.h"
#include "esp_lvgl_port.h"
#include "esp_timer.h"

#include <cstdio>
#include <cstdlib>
#include <cstring>

// Chess. Two badges over the radio eventually; for now one badge, hot seat.
//
// The rules live in chess_rules.cpp and are verified on a host against the
// standard perft suite (tools/chess-perft), so nothing in this file has any
// business deciding what a legal move is. This is a view and an input state
// machine, the way app_sync.cpp is a view over bbx_xfer.
//
// Board geometry is chosen around the one hard constraint: 240 px of height
// has to hold a title bar, eight ranks and a hint line. 24 px cells give a
// 192 px board, which leaves 108 px of side panel — enough for the turn, the
// result and a move list, and wide enough that nothing has to be abbreviated.

// Generated by tools/image-convert/gen-chess-font.sh: seven glyphs, ~8 KB.
extern "C" const lv_font_t font_chess_20;

// Set to 0 to fall back to ASCII letters in lv_font_montserrat_20. That is
// what shipped before the font pipeline existed and is a perfectly good state
// if it ever breaks — the letters need no generated file at all.
#define CHESS_USE_GLYPHS 1

namespace {

constexpr int kCell     = 24;
constexpr int kBoardPx  = 8 * kCell;          // 192
constexpr int kBoardX   = 8;
constexpr int kBoardY   = 24;
constexpr int kPanelX   = kBoardX + kBoardPx + 6;   // 206
constexpr int kPanelW   = 320 - kPanelX - 6;        // 108

// Squares are deliberately low-contrast against each other and high-contrast
// against both piece colours, because a 24 px cell has to carry a 2 px cursor
// border and a piece glyph without either disappearing.
constexpr uint32_t kLightSq     = 0x8a7a8b;
constexpr uint32_t kDarkSq      = 0x3a2a3b;
constexpr uint32_t kLastLight   = 0xb0a05c;   // last move, on a light square
constexpr uint32_t kLastDark    = 0x6a5a2c;   // ...and on a dark one
constexpr uint32_t kSelected    = 0x664167;   // BadgeTheme::ACCENT
constexpr uint32_t kCheckBg     = 0xff5c8a;
constexpr uint32_t kWhitePiece  = 0xfdfdf8;
constexpr uint32_t kBlackPiece  = 0x120912;
constexpr uint32_t kDestMark    = 0x36e07a;
constexpr uint32_t kCursor      = 0xffffff;

constexpr uint8_t kNoSquare = 0xFF;

// U+2022. Present in BOTH fonts a cell label might use: montserrat_20 carries
// it (-r 0x20-0x7F,0xB0,0x2022) and gen-chess-font.sh adds it to the subset
// explicitly, precisely so the legal-move marker never becomes a placeholder
// box when the font is switched.
const char *const kDot = "\xE2\x80\xA2";

#if CHESS_USE_GLYPHS
// Solid glyphs only, U+265A-265F, with COLOUR telling the two sides apart.
// The outline "white" set U+2654-2659 is nearly invisible against this badge's
// dark board, so rendering it would double the font for a worse result.
const char *piece_text(uint8_t pc)
{
    switch (ch_type(pc)) {
        case CH_PAWN:   return "\u265F";
        case CH_KNIGHT: return "\u265E";
        case CH_BISHOP: return "\u265D";
        case CH_ROOK:   return "\u265C";
        case CH_QUEEN:  return "\u265B";
        case CH_KING:   return "\u265A";
        default:        return "";
    }
}
const lv_font_t *cell_font() { return &font_chess_20; }
#else
const char *piece_text(uint8_t pc)
{
    switch (ch_type(pc)) {
        case CH_PAWN:   return "P";
        case CH_KNIGHT: return "N";
        case CH_BISHOP: return "B";
        case CH_ROOK:   return "R";
        case CH_QUEEN:  return "Q";
        case CH_KING:   return "K";
        default:        return "";
    }
}
const lv_font_t *cell_font() { return &lv_font_montserrat_20; }
#endif

const char kPromoLetter[4] = { 'Q', 'R', 'B', 'N' };
const uint8_t kPromoPiece[4] = { CH_QUEEN, CH_ROOK, CH_BISHOP, CH_KNIGHT };

enum class UiMode : uint8_t { Pairing, Browse, Selected, Promote, Menu, GameOver };

const char *mode_name(UiMode m)
{
    switch (m) {
        case UiMode::Pairing:  return "Pairing";
        case UiMode::Browse:   return "Browse";
        case UiMode::Selected: return "Selected";
        case UiMode::Promote:  return "Promote";
        case UiMode::Menu:     return "Menu";
        case UiMode::GameOver: return "GameOver";
    }
    return "?";
}

// The menu is built per-open rather than fixed, because "Resign" is
// meaningless in a hot-seat game and "New game" is meaningless mid-match.
enum class MenuAct : uint8_t { NewGame, Resign, Draw, AcceptDraw, Rematch, Flip };
struct MenuEntry { MenuAct act; const char *label; };
constexpr int kMenuMax = 4;

// Both sides derive the ply from the POSITION rather than counting locally, so
// two badges always agree on the sequence number for the same board. A local
// counter would be one more thing that can drift after a rejoin.
uint16_t ply_of(const ChessPos &p)
{
    return (uint16_t)((p.fullmove - 1) * 2 + (p.stm == CH_BLACK ? 1 : 0));
}

extern "C" const lv_image_dsc_t icon_chess;

class ChessApp final : public GameApp {
public:
    const char *name() const override { return "Chess"; }
    const char *icon() const override { return "CHS"; }
    const lv_image_dsc_t *icon_image() const override { return &icon_chess; }
    const char *slug() const override { return "chess"; }

    // A player thinking about a move presses nothing for minutes at a time,
    // which is exactly the pattern the idle timer reads as "abandoned".
    bool wants_wake_lock() const override { return true; }

    bool confirm_home_exit() const override { return !leaving_; }
    void on_home_confirmation_tick() override { on_tick(); }

    // HOME leaves from every mode via on_button below; the registry must not
    // also intercept it mid-game. While a networked game is live, HOME must
    // NOT fall through to the registry: that calls hal_radio_disable(), which
    // blocks for up to 2 s inside the LVGL lock. Chess takes HOME itself so
    // the radio teardown ordering stays under app control —
    // app_sync.cpp:52-56's reason exactly. HOME uses leave_app() to send
    // the peer a graceful BYE before returning to the launcher.
    //
    // Sub-modes (Selected/Promote/Menu) and GameOver take HOME for the same
    // reason: the app is mid-protocol (or mid-rematch bookkeeping) and the
    // exit must run through on_button, not the registry's blind intercept.
    // B never leaves: it backs out of a sub-mode or opens the menu.
    bool handles_home_button() const override
    {
        if (leaving_) return true;
        if (mode_ == UiMode::Selected || mode_ == UiMode::Promote
            || mode_ == UiMode::Menu) return true;
        return !solo_ && (mp_session_state() == MpState::Live
                          || mode_ == UiMode::GameOver);
    }

    void on_enter(lv_obj_t *root) override
    {
        white_wins_ = hal_config_get_int(slug(), "white_wins", 0);
        black_wins_ = hal_config_get_int(slug(), "black_wins", 0);
        draws_      = hal_config_get_int(slug(), "draws", 0);
        flipped_    = hal_config_get_int(slug(), "flipped", 0) != 0;

        new_game();
        build_ui(root);

        // The registry force-disables the radio on every app switch, so it is
        // always down on the way in here.
        MpConfig cfg{};
        cfg.game               = MPG_GAME_CHESS;
        cfg.bump_threshold_mg  = hal_config_get_int(slug(), "threshold_mg", 300);
        cfg.rssi_min           = hal_config_get_int(slug(), "rssi_min", -60);
        cfg.require_bump       = hal_config_get_int(slug(), "require_bump", 1) != 0;
        solo_   = !mp_session_begin(cfg);
        mode_   = solo_ ? UiMode::Browse : UiMode::Pairing;
        was_live_ = false;
        leaving_  = false;

        last_sig_ = ~0u;
        render();
        s_active = this;
    }

    void on_exit() override
    {
        s_active = nullptr;
        if (!solo_) mp_session_end();   // clears the recv cb FIRST
        // The registry already ran lv_obj_clean(root); deleting anything here
        // would be a double free. Just drop the pointers.
        for (int i = 0; i < 64; ++i) { cells_[i] = nullptr; labels_[i] = nullptr; }
        turn_lbl_ = result_lbl_ = last_lbl_ = score_lbl_ = hint_ = nullptr;
        menu_panel_ = pair_panel_ = pair_title_ = pair_body_ = nullptr;
        for (int i = 0; i < kMenuMax; ++i) menu_lbl_[i] = nullptr;
    }

    void on_tick() override
    {
        if (solo_) { if (flash_ > 0) render(); return; }

        mp_session_tick();

        if (leaving_) {
            if (mp_session_bye_done()) app_registry_return_to_launcher();
            return;
        }

        // game_no is the shared rematch clock. Either badge may advance it, so
        // the game resets when the NUMBER changes rather than when this badge
        // decides to — that is what stops the two from disagreeing about which
        // board they are on.
        if (was_live_ && mp_session_game_no() != last_game_no_) {
            last_game_no_ = mp_session_game_no();
            new_game();
            flipped_ = (my_color() == CH_BLACK);
            draw_offered_ = rematch_offered_ = false;
            mode_ = UiMode::Browse;
        }

        switch (mp_session_state()) {
            case MpState::Live:
                if (!was_live_) {
                    was_live_ = true;
                    last_game_no_ = mp_session_game_no();
                    new_game();
                    // Seat decides orientation. Both badges call the same
                    // antisymmetric function, so exactly one of them flips.
                    flipped_ = (my_color() == CH_BLACK);
                    mode_ = UiMode::Browse;
                }
                handle_inbound();
                publish_state();
                mp_session_set_my_turn(my_turn());
                // Publish FIRST, then leave Live. The peer learns the result
                // from the body we just installed, and leaving Live is what
                // stops publish_state() running again — so doing it in the
                // other order would broadcast the position before the mate.
                if (chess_result_is_over(game_.result)) mp_session_declare_over();
                break;
            case MpState::Over:
            case MpState::Lost:
                if (mode_ != UiMode::Menu && mode_ != UiMode::GameOver)
                    mode_ = UiMode::GameOver;
                break;
            default:
                break;
        }

        // Only touch LVGL when something visible actually changed. Repainting
        // 128 objects at 50 Hz would be wasteful and would visibly flicker —
        // app_sync.cpp:249-293's discipline.
        uint32_t sig = view_sig();
        if (sig != last_sig_ || flash_ > 0) { last_sig_ = sig; render(); }
    }

    void on_button(ButtonEvent ev) override
    {
        if (ev.kind != ButtonEventKind::Pressed) return;
        if (leaving_) return;
        if (!solo_) mp_session_note_activity();

        // HOME completes any live session's BYE before the registry tears
        // down the radio. B remains an in-app menu/dismiss action.
        if (ev.button == Button::Home) { leave_app(); return; }

        // on_button runs from hal_buttons' lv_timer drain, i.e. on the LVGL
        // port task, so this is the honest place to read that task's margin.
        stack_free_ = (uint32_t)uxTaskGetStackHighWaterMark(nullptr);

        switch (mode_) {
            case UiMode::Pairing:  on_pairing(ev.button);  break;
            case UiMode::Browse:   on_browse(ev.button);   break;
            case UiMode::Selected: on_selected(ev.button); break;
            case UiMode::Promote:  on_promote(ev.button);  break;
            case UiMode::Menu:     on_menu(ev.button);     break;
            case UiMode::GameOver: on_gameover(ev.button); break;
        }
        last_sig_ = view_sig();
        render();
    }

    // --- console surface ----------------------------------------------------

    size_t debug(char *out, size_t out_sz)
    {
        char fen[100];
        chess_to_fen(&game_.pos, fen, sizeof(fen));
        char last[6];
        chess_move_to_uci(last_move_, last);

        lv_mem_monitor_t mem;
        lv_mem_monitor(&mem);

        int cell = cell_for(cursor_);
        size_t n = (size_t)snprintf(out, out_sz,
            "mode=%s cur=%c%c cur_cell=%d,%d flipped=%d\n"
            "turn=%c ply=%d fullmove=%u halfmove=%u result=%s check=%d\n"
            "last=%s reps=%d legal=%d score w=%d b=%d d=%d\n"
            "hash=%016llx solo=%d\n"
            "fen=%s\n"
            "lv_mem_used=%u lv_mem_free=%u lv_mem_frag=%u%% lvgl_stack_free=%u\n",
            mode_name(mode_),
            (char)('a' + (cursor_ & 7)), (char)('1' + (cursor_ >> 3)),
            cell & 7, cell >> 3, flipped_ ? 1 : 0,
            game_.pos.stm == CH_WHITE ? 'w' : 'b',
            ply_, (unsigned)game_.pos.fullmove, (unsigned)game_.pos.halfmove,
            chess_result_name(game_.result),
            chess_in_check(&game_.pos, game_.pos.stm) ? 1 : 0,
            last, chess_repetitions(&game_), legal_count(),
            white_wins_, black_wins_, draws_,
            // A space-free digest of the whole position — placement, side to
            // move, castling rights and ep file. `fen=` has spaces in it, so a
            // key=value scraper can only read its first field; this is what
            // duet.py's `agree hash` compares, and it IS a total comparison.
            (unsigned long long)chess_hash(&game_.pos), solo_ ? 1 : 0,
            fen,
            (unsigned)(mem.total_size - mem.free_size), (unsigned)mem.free_size,
            (unsigned)mem.frag_pct,
            (unsigned)stack_free_);
        if (n >= out_sz) return out_sz ? out_sz - 1 : 0;   // truncated; do not walk off
        {
            if (solo_) n += (size_t)snprintf(out + n, out_sz - n,
                                             "mp_state=Solo mp_fail=None duty=Off\n");
            else n += mp_session_debug(out + n, out_sz - n);
        }
        return n;
    }

    bool set_fen(const char *fen)
    {
        ChessPos p;
        if (!chess_from_fen(&p, fen)) return false;
        chess_game_reset(&game_);
        if (!chess_game_adopt(&game_, &p, false)) return false;
        ply_ = 0;
        last_move_ = CH_MOVE_NONE;
        last_from_ = last_to_ = kNoSquare;
        // A position handed to us is not a game we played, so suppress the
        // score counters if the FEN is already a finished game.
        scored_ = chess_result_is_over(game_.result);
        cursor_ = 4;
        leave_selected();
        sync_mode();
        render();
        return true;
    }

    bool play_uci(const char *uci)
    {
        ChessMove m;
        if (!chess_move_from_uci(&game_.pos, uci, &m)) return false;
        if (!apply(m)) return false;
        render();
        return true;
    }

    void new_game()
    {
        chess_game_reset(&game_);
        ply_ = 0;
        last_move_ = CH_MOVE_NONE;
        last_from_ = last_to_ = kNoSquare;
        scored_ = false;
        cursor_ = 4;              // e1, so the first press is near the action
        leave_selected();
        mode_ = UiMode::Browse;
        menu_idx_ = 0;
    }

    void bump() { if (!solo_) mp_session_note_bump(); }

    void flip()
    {
        flipped_ = !flipped_;
        hal_config_set_int(slug(), "flipped", flipped_ ? 1 : 0);
        render();
    }

    ChessPos position_copy() const { return game_.pos; }

private:
    // --- session ----------------------------------------------------------

    uint8_t my_color() const
    {
        return mp_session_seat() == 0 ? CH_WHITE : CH_BLACK;
    }

    bool my_turn() const { return game_.pos.stm == my_color(); }

    // Hot seat lets either side move. A networked game does not: moving for
    // your opponent would publish a position they never agreed to, and since
    // the mover is authoritative they would simply adopt it.
    bool can_move() const
    {
        if (solo_) return true;
        return mp_session_state() == MpState::Live && my_turn();
    }

    void publish_state()
    {
        mpg_chess_body_t b{};
        chess_pack(&game_.pos, (uint8_t *)&b.pos);
        b.last_move = last_move_;
        b.result    = (uint8_t)game_.result;
        int r = chess_repetitions(&game_);
        b.rep_count = (uint8_t)(r > 255 ? 255 : r);
        b.in_check  = chess_in_check(&game_.pos, game_.pos.stm) ? 1 : 0;
        // Idempotent, so calling it every tick costs nothing when nothing moved.
        mp_session_publish(&b, sizeof(b), ply_of(game_.pos));
    }

    void handle_inbound()
    {
        const uint8_t *body = nullptr;
        size_t bl = 0;
        const mpg_hdr_t *h = mp_session_inbound(&body, &bl);
        if (!h) return;
        if (bl < sizeof(mpg_chess_body_t)) { mp_session_take_inbound(); return; }

        mpg_chess_body_t b;
        memcpy(&b, body, sizeof(b));

        ChessPos incoming;
        if (!chess_unpack(&incoming, (const uint8_t *)&b.pos)) {
            ESP_LOGW("chess", "peer sent a position that failed validation");
            mp_session_take_inbound();
            return;
        }

        const uint16_t mine = ply_of(game_.pos);
        const uint16_t theirs = h->seq;

        if (theirs > mine) {
            const bool contiguous = (theirs == mine + 1);

            // Bug-catcher, not a gate. Apply their claimed move to OUR board
            // and see whether we land where they say. On a mismatch we still
            // adopt — the mover is authoritative for the result of its own
            // move, and deadlocking two badges over a disagreement is far
            // worse than one of them being briefly wrong — but we log both
            // positions so the bug is reproducible from a FEN.
            if (contiguous && b.last_move != CH_MOVE_NONE) {
                ChessPos expect = game_.pos;
                ChessUndo u;
                if (chess_make(&expect, b.last_move, &u)
                    && chess_hash(&expect) != chess_hash(&incoming)) {
                    char a[100], c[100];
                    chess_to_fen(&expect, a, sizeof(a));
                    chess_to_fen(&incoming, c, sizeof(c));
                    ESP_LOGE("chess", "desync: expected %s got %s", a, c);
                }
            }

            chess_game_adopt(&game_, &incoming, contiguous);
            last_move_ = b.last_move;
            if (last_move_ == CH_MOVE_NONE) {
                last_from_ = last_to_ = kNoSquare;
            } else {
                last_from_ = ch_move_from(last_move_);
                last_to_   = ch_move_to(last_move_);
            }

            // The mover is authoritative for the result: only they can know
            // they resigned, and only they hold the repetition history that
            // justifies a threefold claim after we rejoined mid-game.
            ChessResult claimed = (ChessResult)b.result;
            if (chess_result_is_over(claimed) && !chess_result_is_over(game_.result))
                game_.result = claimed;

            leave_selected();
            if (chess_result_is_over(game_.result)) {
                mode_ = UiMode::GameOver;
                record_score();
                mp_session_declare_over();
            } else if (mode_ != UiMode::Menu) {
                mode_ = UiMode::Browse;
            }
        }

        // Ack whatever we just saw, even a repeat: our ack fields are how the
        // peer learns it can stop pushing.
        mp_session_ack(h->seq, h->sum);
        mp_session_take_inbound();
    }

    // Everything the board actually shows. Cheaper than diffing 128 widgets,
    // and it is the whole reason on_tick can run at 50 Hz without repainting.
    uint32_t view_sig() const
    {
        uint32_t v = (uint32_t)mode_;
        v = v * 31 + cursor_;
        v = v * 31 + sel_;
        v = v * 31 + ply_of(game_.pos);
        v = v * 31 + (uint32_t)game_.result;
        v = v * 31 + (uint32_t)(solo_ ? 0 : (int)mp_session_state());
        v = v * 31 + (uint32_t)(solo_ ? 0 : mp_session_candidates());
        v = v * 31 + (uint32_t)(solo_ ? 0 : (int)mp_session_fail());
        v = v * 31 + (uint32_t)(solo_ ? 0 : mp_session_game_no());
        v = v * 31 + (uint32_t)(solo_ ? 0 : (mp_session_peer_flag(MPG_FLAG_DRAW_OFFER) ? 1 : 0));
        v = v * 31 + (uint32_t)(solo_ ? 0 : (mp_session_peer_flag(MPG_FLAG_REMATCH) ? 1 : 0));
        v = v * 31 + (rematch_offered_ ? 1u : 0u);
        v = v * 31 + (draw_offered_ ? 1u : 0u);
        v = v * 31 + (uint32_t)menu_idx_;
        v = v * 31 + (uint32_t)promo_idx_;
        v = v * 31 + (flipped_ ? 1u : 0u);
        return v;
    }

    void leave_app()
    {
        if (solo_) { app_registry_return_to_launcher(); return; }
        // A clean exit tells the peer rather than making them wait out
        // kPeerLostTicks. It cannot be done from on_exit(), which runs
        // synchronously under the LVGL lock immediately before the registry's
        // hal_radio_disable() — there are no ticks left in which to hold it.
        leaving_ = true;
        mp_session_say_bye();
    }

    // --- orientation ------------------------------------------------------
    //
    // ONE function and its inverse, and nothing anywhere else in this file may
    // convert between a board square and a screen cell. Board orientation is
    // the classic bug in a chess UI: Black sees the board flipped, but D-pad
    // Up must still move toward the top of the SCREEN for both players. Both
    // coordinates are printed by debug() so a flip bug is a failed assertion
    // rather than a squint at a screenshot.

    int cell_for(uint8_t sq) const
    {
        int r = sq >> 3, f = sq & 7;
        return flipped_ ? (r * 8 + (7 - f)) : ((7 - r) * 8 + f);
    }

    uint8_t sq_for(int cell) const
    {
        int row = cell >> 3, col = cell & 7;
        return flipped_ ? (uint8_t)(row * 8 + (7 - col))
                        : (uint8_t)((7 - row) * 8 + col);
    }

    void move_cursor(int dcol, int drow)
    {
        int cell = cell_for(cursor_);
        int row = (cell >> 3) + drow;
        int col = (cell & 7) + dcol;
        // Clamped, not wrapped. Wrapping on an 8x8 board is disorienting —
        // you lose track of which edge you came off.
        if (row < 0) row = 0; else if (row > 7) row = 7;
        if (col < 0) col = 0; else if (col > 7) col = 7;
        cursor_ = sq_for(row * 8 + col);
    }

    // --- game -------------------------------------------------------------

    void leave_selected()
    {
        sel_ = kNoSquare;
        move_count_ = 0;
        pending_ = CH_MOVE_NONE;
        promo_idx_ = 0;
    }

    int legal_count()
    {
        ChessMove buf[CH_MAX_MOVES];
        return chess_gen_legal(&game_.pos, buf, CH_MAX_MOVES);
    }

    bool is_dest(uint8_t sq) const
    {
        for (int i = 0; i < move_count_; ++i)
            if (ch_move_to(moves_[i]) == sq) return true;
        return false;
    }

    bool select(uint8_t sq)
    {
        if (!can_move()) return false;
        uint8_t pc = chess_piece_at(&game_.pos, sq);
        if (pc == CH_EMPTY || ch_color(pc) != game_.pos.stm) return false;
        move_count_ = chess_moves_from(&game_.pos, sq, moves_, CH_MAX_MOVES);
        if (move_count_ == 0) return false;   // a pinned piece is not selectable
        sel_ = sq;
        mode_ = UiMode::Selected;
        return true;
    }

    bool apply(ChessMove m)
    {
        if (!chess_game_play(&game_, m)) return false;
        last_move_ = m;
        last_from_ = ch_move_from(m);
        last_to_   = ch_move_to(m);
        ply_++;
        leave_selected();
        sync_mode();
        return true;
    }

    // Fold the rules' verdict into the UI mode. Called after anything that can
    // end a game, so there is one place that decides the game is over.
    void sync_mode()
    {
        if (chess_result_is_over(game_.result)) {
            mode_ = UiMode::GameOver;
            record_score();
        } else if (mode_ == UiMode::GameOver) {
            mode_ = UiMode::Browse;
        } else if (mode_ != UiMode::Menu) {
            mode_ = UiMode::Browse;
        }
    }

    void record_score()
    {
        if (scored_) return;
        scored_ = true;
        switch (game_.result) {
            case ChessResult::WhiteMates:
            case ChessResult::BlackResigns:
                white_wins_++;
                hal_config_set_int(slug(), "white_wins", white_wins_);
                break;
            case ChessResult::BlackMates:
            case ChessResult::WhiteResigns:
                black_wins_++;
                hal_config_set_int(slug(), "black_wins", black_wins_);
                break;
            default:
                draws_++;
                hal_config_set_int(slug(), "draws", draws_);
                break;
        }
    }

    // --- input ------------------------------------------------------------

    void on_pairing(Button b)
    {
        switch (b) {
            case Button::B:
                // Give up on a partner and play both sides. Ending the session
                // here also drops the 100% pairing scan, which is the single
                // most expensive thing this badge does.
                mp_session_end();
                // ...but mp_session_end() also releases the sleep wake lock,
                // and a hot-seat game still needs it: a player thinking about
                // a move presses nothing for minutes. app_registry.cpp:79 read
                // wants_wake_lock() once at launch and will not ask again.
                hal_sleep_wake_lock(true);
                solo_ = true;
                new_game();
                mode_ = UiMode::Browse;
                break;
            case Button::A: mp_session_note_button(); break;
            // A pairs nearby badges; B selects pass-and-play.
            default: break;
        }
    }

    void on_browse(Button b)
    {
        switch (b) {
            case Button::Up:    move_cursor(0, -1); break;
            case Button::Down:  move_cursor(0, +1); break;
            case Button::Left:  move_cursor(-1, 0); break;
            case Button::Right: move_cursor(+1, 0); break;
            case Button::A:     if (!select(cursor_)) flash_ = 10; break;
            case Button::B:
            case Button::Start: open_menu(); break;
            default: break;
        }
    }

    void on_selected(Button b)
    {
        switch (b) {
            case Button::Up:    move_cursor(0, -1); break;
            case Button::Down:  move_cursor(0, +1); break;
            case Button::Left:  move_cursor(-1, 0); break;
            case Button::Right: move_cursor(+1, 0); break;
            case Button::B:     leave_selected(); mode_ = UiMode::Browse; break;
            case Button::Start: leave_selected(); open_menu(); break;
            case Button::A:     confirm_destination(); break;
            default: break;
        }
    }

    void confirm_destination()
    {
        if (cursor_ == sel_) {                    // tapping the piece again
            leave_selected();
            mode_ = UiMode::Browse;
            return;
        }
        if (is_dest(cursor_)) {
            if (chess_needs_promotion(&game_.pos, sel_, cursor_)) {
                pending_   = ch_move(sel_, cursor_, CH_QUEEN);
                promo_idx_ = 0;
                mode_      = UiMode::Promote;
                return;
            }
            // The generator already produced the exact move; find it rather
            // than reconstructing one, so castling and en passant come through
            // with whatever encoding chess_rules chose.
            for (int i = 0; i < move_count_; ++i) {
                if (ch_move_to(moves_[i]) == cursor_) { apply(moves_[i]); return; }
            }
        }
        // Landing on another of your own pieces re-selects it. Without this,
        // every mis-tap costs two presses, which on a D-pad is most of them.
        uint8_t pc = chess_piece_at(&game_.pos, cursor_);
        if (pc != CH_EMPTY && ch_color(pc) == game_.pos.stm) {
            if (select(cursor_)) return;
        }
        flash_ = 10;
    }

    void on_promote(Button b)
    {
        switch (b) {
            case Button::Left:  promo_idx_ = (promo_idx_ + 3) % 4; break;
            case Button::Right: promo_idx_ = (promo_idx_ + 1) % 4; break;
            case Button::B:     mode_ = UiMode::Selected; break;
            case Button::A: {
                ChessMove want = ch_move(ch_move_from(pending_),
                                         ch_move_to(pending_),
                                         kPromoPiece[promo_idx_]);
                for (int i = 0; i < move_count_; ++i)
                    if (moves_[i] == want) { apply(want); return; }
                mode_ = UiMode::Selected;   // should not happen; fail visibly
                break;
            }
            default: break;
        }
    }

    void open_menu()
    {
        menu_n_ = 0;
        if (solo_) {
            menu_[menu_n_++] = { MenuAct::NewGame, "New game" };
        } else if (mp_session_state() == MpState::Live) {
            menu_[menu_n_++] = { MenuAct::Resign, "Resign" };
            // Their offer is standing, so the useful action is accepting it,
            // not making a second one back at them.
            if (mp_session_peer_flag(MPG_FLAG_DRAW_OFFER))
                menu_[menu_n_++] = { MenuAct::AcceptDraw, "Accept draw" };
            else
                menu_[menu_n_++] = { MenuAct::Draw, "Offer draw" };
        } else {
            menu_[menu_n_++] = { MenuAct::Rematch, "Rematch" };
        }
        menu_[menu_n_++] = { MenuAct::Flip,  "Flip board" };
        menu_idx_ = 0;
        leave_selected();
        mode_ = UiMode::Menu;
    }

    void on_menu(Button b)
    {
        switch (b) {
            case Button::Up:   menu_idx_ = (menu_idx_ + menu_n_ - 1) % menu_n_; break;
            case Button::Down: menu_idx_ = (menu_idx_ + 1) % menu_n_; break;
            case Button::B:
            case Button::Start: mode_ = pairing_pending() ? UiMode::Pairing
                                                         : UiMode::Browse; break;
            case Button::A: activate_menu(); break;
            default: break;
        }
    }

    bool pairing_pending() const
    {
        return !solo_ && (mp_session_state() == MpState::Seeking
                          || mp_session_state() == MpState::Proposed);
    }

    void activate_menu()
    {
        switch (menu_[menu_idx_].act) {
            case MenuAct::NewGame:
                new_game();
                break;
            case MenuAct::Resign:
                // The rules module names the result from the resigning side's
                // colour, and publish_state carries it, so the peer adopts the
                // same verdict rather than inferring one.
                game_.result = (my_color() == CH_WHITE) ? ChessResult::WhiteResigns
                                                        : ChessResult::BlackResigns;
                record_score();
                publish_state();
                mp_session_resign();
                mode_ = UiMode::GameOver;
                break;
            case MenuAct::Draw:
                draw_offered_ = !draw_offered_;
                mp_session_offer_draw(draw_offered_);
                mode_ = UiMode::Browse;
                break;
            case MenuAct::AcceptDraw:
                // Accepting is a result, and the result travels in the body,
                // so the peer adopts our verdict rather than inferring one
                // from a flag that could arrive without context.
                game_.result = ChessResult::DrawAgreed;
                record_score();
                publish_state();
                mp_session_declare_over();
                mode_ = UiMode::GameOver;
                break;
            case MenuAct::Rematch:
                rematch_offered_ = !rematch_offered_;
                mp_session_offer_rematch(rematch_offered_);
                mode_ = UiMode::GameOver;
                break;
            case MenuAct::Flip:
                flipped_ = !flipped_;
                hal_config_set_int(slug(), "flipped", flipped_ ? 1 : 0);
                mode_ = UiMode::Browse;
                break;
        }
    }

    void on_gameover(Button b)
    {
        if (b == Button::A) {
            if (solo_) { new_game(); return; }
            rematch_offered_ = !rematch_offered_;
            mp_session_offer_rematch(rematch_offered_);
            return;
        }
        // B and Start open the in-game menu; only HOME leaves the app.
        if (b == Button::Start || b == Button::B) open_menu();
    }

    // --- rendering --------------------------------------------------------

    void build_ui(lv_obj_t *root)
    {
        lv_obj_t *title = lv_label_create(root);
        lv_label_set_text(title, "Chess");
        lv_obj_set_style_text_font(title, &lv_font_montserrat_16, 0);
        lv_obj_set_style_text_color(title, lv_color_hex(BadgeTheme::TEXT), 0);
        lv_obj_align(title, LV_ALIGN_TOP_LEFT, kBoardX, 4);

        // 64 cells and 64 labels, created once and thereafter only restyled.
        // Creating and destroying widgets as pieces move would churn the LVGL
        // heap on every ply; app_tetris.cpp:242-262 sets the precedent.
        for (int cell = 0; cell < 64; ++cell) {
            int row = cell >> 3, col = cell & 7;
            lv_obj_t *c = lv_obj_create(root);
            lv_obj_remove_style_all(c);
            lv_obj_set_size(c, kCell, kCell);
            lv_obj_set_pos(c, kBoardX + col * kCell, kBoardY + row * kCell);
            lv_obj_set_style_bg_opa(c, LV_OPA_COVER, 0);
            lv_obj_set_style_radius(c, 0, 0);
            lv_obj_clear_flag(c, LV_OBJ_FLAG_SCROLLABLE);

            lv_obj_t *l = lv_label_create(c);
            lv_obj_set_style_text_font(l, cell_font(), 0);
            lv_obj_center(l);
            lv_label_set_text(l, "");

            cells_[cell]  = c;
            labels_[cell] = l;
        }

        turn_lbl_ = panel_label(root, 0, &lv_font_montserrat_16);
        result_lbl_ = panel_label(root, 22, &lv_font_montserrat_14);
        last_lbl_ = panel_label(root, 44, &lv_font_montserrat_14);
        score_lbl_ = panel_label(root, 66, &lv_font_montserrat_14);

        hint_ = lv_label_create(root);
        lv_obj_set_style_text_font(hint_, &lv_font_montserrat_14, 0);
        lv_obj_set_style_text_color(hint_, lv_color_hex(BadgeTheme::TEXT_MUTED), 0);
        lv_obj_align(hint_, LV_ALIGN_BOTTOM_LEFT, kBoardX, -4);

        build_menu(root);
    }

    lv_obj_t *panel_label(lv_obj_t *root, int dy, const lv_font_t *font)
    {
        lv_obj_t *l = lv_label_create(root);
        lv_obj_set_style_text_font(l, font, 0);
        lv_obj_set_style_text_color(l, lv_color_hex(BadgeTheme::TEXT), 0);
        lv_obj_set_width(l, kPanelW);
        lv_label_set_long_mode(l, LV_LABEL_LONG_MODE_WRAP);
        lv_obj_set_pos(l, kPanelX, kBoardY + dy);
        lv_label_set_text(l, "");
        return l;
    }

    void build_menu(lv_obj_t *root)
    {
        menu_panel_ = lv_obj_create(root);
        lv_obj_remove_style_all(menu_panel_);
        lv_obj_set_size(menu_panel_, 160, 22 * kMenuMax + 16);
        lv_obj_align(menu_panel_, LV_ALIGN_CENTER, 0, 0);
        lv_obj_set_style_bg_color(menu_panel_, lv_color_hex(BadgeTheme::PANEL), 0);
        lv_obj_set_style_bg_opa(menu_panel_, LV_OPA_COVER, 0);
        lv_obj_set_style_border_width(menu_panel_, 2, 0);
        lv_obj_set_style_border_color(menu_panel_,
                                      lv_color_hex(BadgeTheme::ACCENT_DETAIL), 0);
        lv_obj_set_style_radius(menu_panel_, 6, 0);
        lv_obj_clear_flag(menu_panel_, LV_OBJ_FLAG_SCROLLABLE);

        for (int i = 0; i < kMenuMax; ++i) {
            lv_obj_t *l = lv_label_create(menu_panel_);
            lv_obj_set_style_text_font(l, &lv_font_montserrat_16, 0);
            lv_obj_set_pos(l, 12, 8 + i * 22);
            lv_label_set_text(l, "");
            menu_lbl_[i] = l;
        }
        lv_obj_add_flag(menu_panel_, LV_OBJ_FLAG_HIDDEN);

        // Pairing overlay. Same top-of-the-pile idiom as the menu; the board
        // stays built underneath so entering a game is a repaint, not a
        // rebuild of 128 objects.
        pair_panel_ = lv_obj_create(root);
        lv_obj_remove_style_all(pair_panel_);
        lv_obj_set_size(pair_panel_, 240, 120);
        lv_obj_align(pair_panel_, LV_ALIGN_CENTER, 0, 0);
        lv_obj_set_style_bg_color(pair_panel_, lv_color_hex(BadgeTheme::PANEL), 0);
        lv_obj_set_style_bg_opa(pair_panel_, LV_OPA_COVER, 0);
        lv_obj_set_style_border_width(pair_panel_, 2, 0);
        lv_obj_set_style_border_color(pair_panel_,
                                      lv_color_hex(BadgeTheme::ACCENT_DETAIL), 0);
        lv_obj_set_style_radius(pair_panel_, 6, 0);
        lv_obj_clear_flag(pair_panel_, LV_OBJ_FLAG_SCROLLABLE);

        pair_title_ = lv_label_create(pair_panel_);
        lv_obj_set_style_text_font(pair_title_, &lv_font_montserrat_20, 0);
        lv_obj_set_style_text_color(pair_title_, lv_color_hex(BadgeTheme::TEXT), 0);
        lv_obj_set_pos(pair_title_, 16, 14);

        pair_body_ = lv_label_create(pair_panel_);
        lv_obj_set_style_text_font(pair_body_, &lv_font_montserrat_14, 0);
        lv_obj_set_style_text_color(pair_body_, lv_color_hex(BadgeTheme::TEXT_MUTED), 0);
        lv_obj_set_width(pair_body_, 208);
        lv_label_set_long_mode(pair_body_, LV_LABEL_LONG_MODE_WRAP);
        lv_obj_set_pos(pair_body_, 16, 44);
        lv_obj_add_flag(pair_panel_, LV_OBJ_FLAG_HIDDEN);
    }

    void render_pairing()
    {
        if (!pair_panel_) return;
        if (mode_ != UiMode::Pairing) {
            lv_obj_add_flag(pair_panel_, LV_OBJ_FLAG_HIDDEN);
            return;
        }
        lv_obj_clear_flag(pair_panel_, LV_OBJ_FLAG_HIDDEN);

        MpState st = mp_session_state();
        MpFail  fl = mp_session_fail();
        int cands = mp_session_candidates();

        if (st == MpState::Proposed) {
            lv_label_set_text(pair_title_, "Found you");
            lv_label_set_text_fmt(pair_body_, "Agreeing on colours...\nYou play %s",
                                  mp_session_seat() == 0 ? "White" : "Black");
        } else if (fl == MpFail::NoPartner) {
            lv_label_set_text(pair_title_, "No partner");
            lv_label_set_text(pair_body_, "Nobody bumped back.\n"
                                          "A: pair    B: pass and play");
        } else if (fl == MpFail::SeatClash) {
            lv_label_set_text(pair_title_, "Pairing failed");
            lv_label_set_text(pair_body_, "Both badges picked the same colour.\n"
                                          "A: try again");
        } else if (cands > 0) {
            lv_label_set_text(pair_title_, "BOTH PRESS A");
            lv_label_set_text_fmt(pair_body_,
                                  "%d badge%s nearby, %d dBm.\nStay within 5 cm; press within 1 second.",
                                  cands, cands == 1 ? "" : "s", mp_session_peer_rssi());
        } else {
            lv_label_set_text(pair_title_, "BOTH PRESS A");
            lv_label_set_text(pair_body_, "Open Chess on both badges.\n"
                                          "Stay within 5 cm; press within 1 second.");
        }
    }

    void render()
    {
        if (!cells_[0]) return;

        const bool in_check = chess_in_check(&game_.pos, game_.pos.stm);

        for (int cell = 0; cell < 64; ++cell) {
            uint8_t sq = sq_for(cell);
            uint8_t pc = chess_piece_at(&game_.pos, sq);
            bool light = (((sq >> 3) + (sq & 7)) & 1) != 0;

            uint32_t bg = light ? kLightSq : kDarkSq;
            if (sq == last_from_ || sq == last_to_) bg = light ? kLastLight : kLastDark;
            if (mode_ == UiMode::Selected && sq == sel_) bg = kSelected;
            if (in_check && pc != CH_EMPTY && ch_type(pc) == CH_KING
                && ch_color(pc) == game_.pos.stm) bg = kCheckBg;
            lv_obj_set_style_bg_color(cells_[cell], lv_color_hex(bg), 0);

            bool dest = (mode_ == UiMode::Selected || mode_ == UiMode::Promote)
                        && is_dest(sq);
            if (pc == CH_EMPTY) {
                lv_label_set_text(labels_[cell], dest ? kDot : "");
                lv_obj_set_style_text_color(labels_[cell],
                                            lv_color_hex(kDestMark), 0);
            } else {
                lv_label_set_text(labels_[cell], piece_text(pc));
                lv_obj_set_style_text_color(labels_[cell],
                    lv_color_hex(ch_color(pc) == CH_WHITE ? kWhitePiece
                                                          : kBlackPiece), 0);
            }

            uint32_t border = kDestMark;
            int bw = 0;
            if (dest && pc != CH_EMPTY) bw = 2;          // a capture worth seeing
            if (sq == cursor_ && mode_ != UiMode::Menu) { border = kCursor; bw = 2; }
            lv_obj_set_style_border_color(cells_[cell], lv_color_hex(border), 0);
            lv_obj_set_style_border_width(cells_[cell], bw, 0);
        }

        render_panel();
        render_hint();

        if (menu_panel_) {
            if (mode_ == UiMode::Menu) lv_obj_clear_flag(menu_panel_, LV_OBJ_FLAG_HIDDEN);
            else lv_obj_add_flag(menu_panel_, LV_OBJ_FLAG_HIDDEN);
            for (int i = 0; i < kMenuMax; ++i) {
                if (!menu_lbl_[i]) continue;
                const char *txt = "";
                if (i < menu_n_) {
                    txt = menu_[i].label;
                    if (menu_[i].act == MenuAct::Draw && draw_offered_)
                        txt = "Draw offered";
                    else if (menu_[i].act == MenuAct::Rematch && rematch_offered_)
                        txt = "Rematch offered";
                }
                lv_label_set_text(menu_lbl_[i], txt);
                lv_obj_set_style_text_color(menu_lbl_[i],
                    lv_color_hex(i == menu_idx_ ? BadgeTheme::TEXT
                                                : BadgeTheme::TEXT_MUTED), 0);
            }
        }
        render_pairing();
    }

    void render_panel()
    {
        if (turn_lbl_) {
            const char *side = game_.pos.stm == CH_WHITE ? "White" : "Black";
            if (solo_) lv_label_set_text_fmt(turn_lbl_, "%s to move", side);
            else lv_label_set_text_fmt(turn_lbl_, "%s%s", side,
                                       my_turn() ? " - you" : " - them");
        }
        if (result_lbl_) {
            if (mode_ == UiMode::Promote) {
                // Built by hand rather than with a running snprintf: the
                // project builds with -Werror=format-truncation, and a
                // shrinking `sizeof(buf) - n` bound is exactly the shape that
                // trips it.
                char buf[16];
                int n = 0;
                for (int i = 0; i < 4; ++i) {
                    buf[n++] = (i == promo_idx_) ? '[' : ' ';
                    buf[n++] = kPromoLetter[i];
                    buf[n++] = (i == promo_idx_) ? ']' : ' ';
                }
                buf[n] = '\0';
                lv_label_set_text(result_lbl_, buf);
                lv_obj_set_style_text_color(result_lbl_,
                                            lv_color_hex(0xffd166), 0);
            } else if (chess_result_is_over(game_.result)) {
                lv_label_set_text(result_lbl_, chess_result_name(game_.result));
                lv_obj_set_style_text_color(result_lbl_,
                                            lv_color_hex(0xffd166), 0);
            } else if (!solo_ && mp_session_peer_flag(MPG_FLAG_DRAW_OFFER)) {
                lv_label_set_text(result_lbl_, "Draw offered");
                lv_obj_set_style_text_color(result_lbl_,
                                            lv_color_hex(0xffd166), 0);
            } else if (chess_in_check(&game_.pos, game_.pos.stm)) {
                lv_label_set_text(result_lbl_, "Check");
                lv_obj_set_style_text_color(result_lbl_,
                                            lv_color_hex(kCheckBg), 0);
            } else {
                lv_label_set_text(result_lbl_, "");
            }
        }
        if (last_lbl_) {
            if (last_move_ == CH_MOVE_NONE) {
                lv_label_set_text_fmt(last_lbl_, "move %u",
                                      (unsigned)game_.pos.fullmove);
            } else {
                char uci[6];
                chess_move_to_uci(last_move_, uci);
                lv_label_set_text_fmt(last_lbl_, "%u. %s",
                                      (unsigned)game_.pos.fullmove, uci);
            }
        }
        if (score_lbl_)
            lv_label_set_text_fmt(score_lbl_, "W %d\nB %d\nD %d",
                                  white_wins_, black_wins_, draws_);
    }

    // The hint line is user-facing help that also happens to name the input
    // mode, so `badge.py tree expect "A: place"` asserts the state machine
    // without any debug text on a shipping screen.
    void render_hint()
    {
        if (!hint_) return;
        const char *t = "";
        switch (mode_) {
            case UiMode::Pairing:  t = "A: pair   B: pass and play"; break;
            case UiMode::Browse:
                t = (solo_ || can_move()) ? "A: pick up   Start: menu"
                                          : "Waiting for your opponent";
                break;
            case UiMode::Selected: t = "A: place   B: cancel";     break;
            case UiMode::Promote:  t = "L/R: piece   A: confirm";  break;
            case UiMode::Menu:     t = "U/D: choose   A: pick";    break;
            case UiMode::GameOver:
                if (solo_) t = "A: new game   B: menu";
                else if (rematch_offered_ && mp_session_peer_flag(MPG_FLAG_REMATCH))
                    t = "Starting a rematch...";
                else if (mp_session_peer_flag(MPG_FLAG_REMATCH))
                    t = "Rematch offered   A: accept";
                else t = rematch_offered_ ? "Waiting for a rematch   B: menu"
                                          : "A: rematch   B: menu";
                break;
        }
        lv_label_set_text(hint_, t);
        lv_obj_set_style_text_color(hint_,
            lv_color_hex(flash_ > 0 ? kCheckBg : BadgeTheme::TEXT_MUTED), 0);
        if (flash_ > 0) flash_--;
    }

    ChessGame game_{};
    ChessMove moves_[CH_MAX_MOVES] = {};   // 436 B, a member so it is never
    int       move_count_ = 0;             // on the 7168-byte LVGL stack
    ChessMove pending_    = CH_MOVE_NONE;
    ChessMove last_move_  = CH_MOVE_NONE;

    uint8_t cursor_    = 4;
    uint8_t sel_       = kNoSquare;
    uint8_t last_from_ = kNoSquare;
    uint8_t last_to_   = kNoSquare;

    UiMode mode_     = UiMode::Pairing;
    int    promo_idx_ = 0;
    int    menu_idx_  = 0;
    int    ply_       = 0;
    int    flash_     = 0;
    uint32_t stack_free_ = 0;   // LVGL task margin, sampled in on_button
    bool   flipped_   = false;
    bool   scored_    = false;
    bool   solo_      = false;   // pairing gave up, or never started: hot seat
    bool   was_live_  = false;
    bool   leaving_   = false;   // holding a BYE before returning to the launcher
    bool   draw_offered_    = false;
    bool   rematch_offered_ = false;
    uint8_t last_game_no_   = 0;
    uint32_t last_sig_ = ~0u;

    MenuEntry menu_[kMenuMax] = {};
    int       menu_n_ = 0;

    int white_wins_ = 0, black_wins_ = 0, draws_ = 0;

    lv_obj_t *cells_[64]  = {};
    lv_obj_t *labels_[64] = {};
    lv_obj_t *turn_lbl_ = nullptr, *result_lbl_ = nullptr;
    lv_obj_t *last_lbl_ = nullptr, *score_lbl_ = nullptr, *hint_ = nullptr;
    lv_obj_t *menu_panel_ = nullptr;
    lv_obj_t *menu_lbl_[kMenuMax] = {};
    lv_obj_t *pair_panel_ = nullptr, *pair_title_ = nullptr, *pair_body_ = nullptr;

public:
    // Set only while foregrounded, so the console can tell "not the active
    // app" from "active but idle" instead of poking at a stale instance.
    static ChessApp *s_active;
};

ChessApp *ChessApp::s_active = nullptr;

ChessApp s_instance;

}  // namespace

App *app_chess_instance() { return &s_instance; }

// --- console surface --------------------------------------------------------
//
// The REPL runs on its own task. Every entry point below takes the LVGL lock,
// because it mutates state that the 50 Hz tick and the render path both touch.

size_t chess_app_debug(char *out, size_t out_sz)
{
    if (out_sz) out[0] = '\0';
    lvgl_port_lock(0);
    size_t n = ChessApp::s_active ? ChessApp::s_active->debug(out, out_sz) : 0;
    lvgl_port_unlock();
    return n;
}

bool chess_app_set_fen(const char *fen)
{
    lvgl_port_lock(0);
    bool ok = ChessApp::s_active && ChessApp::s_active->set_fen(fen);
    lvgl_port_unlock();
    return ok;
}

bool chess_app_play_uci(const char *uci)
{
    lvgl_port_lock(0);
    bool ok = ChessApp::s_active && ChessApp::s_active->play_uci(uci);
    lvgl_port_unlock();
    return ok;
}

bool chess_app_new_game()
{
    lvgl_port_lock(0);
    bool ok = ChessApp::s_active != nullptr;
    if (ok) { ChessApp::s_active->new_game(); }
    lvgl_port_unlock();
    return ok;
}

bool chess_app_bump()
{
    lvgl_port_lock(0);
    bool ok = ChessApp::s_active != nullptr;
    if (ok) ChessApp::s_active->bump();
    lvgl_port_unlock();
    return ok;
}

bool chess_app_flip()
{
    lvgl_port_lock(0);
    bool ok = ChessApp::s_active != nullptr;
    if (ok) ChessApp::s_active->flip();
    lvgl_port_unlock();
    return ok;
}

bool chess_app_perft(int depth, uint64_t *out_nodes, uint32_t *out_ms)
{
    if (depth < 1) depth = 1;

    // Snapshot under the lock, then let it go. Perft at depth 4 is seconds of
    // work at 80 MHz; holding the LVGL lock across it would freeze the panel
    // and stall the registry's tick.
    lvgl_port_lock(0);
    bool active = ChessApp::s_active != nullptr;
    ChessPos pos{};
    if (active) pos = ChessApp::s_active->position_copy();
    lvgl_port_unlock();
    if (!active) return false;

    // Heap, not stack: CH_MAX_MOVES * 4 moves is 1744 bytes, and the console
    // task has no room to spare for it.
    ChessMove *scratch = (ChessMove *)malloc(sizeof(ChessMove) * CH_MAX_MOVES * (size_t)depth);
    if (!scratch) return false;

    int64_t t0 = esp_timer_get_time();
    uint64_t nodes = chess_perft(&pos, depth, scratch);
    int64_t t1 = esp_timer_get_time();
    free(scratch);

    if (out_nodes) *out_nodes = nodes;
    if (out_ms) *out_ms = (uint32_t)((t1 - t0) / 1000);
    return true;
}
